/*
 * Copyright (c) 2020 Pete Johanson
 *
 * SPDX-License-Identifier: MIT
 */

#include "chipper.dtsi"

// &five_column_transform {
//  	col-offset = <6>;
// };

&default_transform {
	col-offset = <6>;
};

&kscan0 {
	col-gpios
		= <&gpio1 11 (GPIO_ACTIVE_HIGH | GPIO_PULL_DOWN)>	//Col0
		, <&gpio1 12 (GPIO_ACTIVE_HIGH | GPIO_PULL_DOWN)>  //Col1
		, <&gpio1 13 (GPIO_ACTIVE_HIGH | GPIO_PULL_DOWN)>  //Col2
		, <&gpio1 14 (GPIO_ACTIVE_HIGH | GPIO_PULL_DOWN)>  //Col3
		, <&gpio1 15 (GPIO_ACTIVE_HIGH | GPIO_PULL_DOWN)>  //Col4
		, <&gpio0 10 (GPIO_ACTIVE_HIGH | GPIO_PULL_DOWN)>  //Col5
		;
};
